## drivers/platform/xiaomi/Kconfig
```kconfig
# Xiaomi configuration options

menu "Xiaomi board selection"
	depends on ARCH_QCOM

	config MACH_XIAOMI_CITRUS
		bool "Xiaomi citrus board"
		depends on ARCH_BENGAL
		help
		  Support for XiaoMi citrus board

endmenu
```
